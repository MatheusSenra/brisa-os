## buildroot/Config.in
```kconfig
menu "Brisa OS"

comment "Sistema"
source "$BR2_EXTERNAL_BRISA_PATH/package/brisa-ui/Config.in"
source "$BR2_EXTERNAL_BRISA_PATH/package/brisa-vendor/Config.in"
source "$BR2_EXTERNAL_BRISA_PATH/package/brisa-mali/Config.in"

comment "Emulação"
source "$BR2_EXTERNAL_BRISA_PATH/package/brisa-retroarch/Config.in"
source "$BR2_EXTERNAL_BRISA_PATH/package/libretro-fceumm/Config.in"
source "$BR2_EXTERNAL_BRISA_PATH/package/libretro-gambatte/Config.in"
source "$BR2_EXTERNAL_BRISA_PATH/package/libretro-mgba/Config.in"
source "$BR2_EXTERNAL_BRISA_PATH/package/libretro-pcsx-rearmed/Config.in"
source "$BR2_EXTERNAL_BRISA_PATH/package/libretro-picodrive/Config.in"
source "$BR2_EXTERNAL_BRISA_PATH/package/libretro-snes9x/Config.in"

endmenu
```

## buildroot/package/brisa-mali/Config.in
```kconfig
config BR2_PACKAGE_BRISA_MALI
	bool "brisa-mali"
	depends on BR2_PACKAGE_BRISA_VENDOR
	select BR2_PACKAGE_HAS_LIBEGL
	select BR2_PACKAGE_HAS_LIBGLES
	select BR2_PACKAGE_MESA3D_HEADERS
	help
	  Driver de espaço de usuário da Mali-G31 (libmali) tirado do
	  firmware stock. Fornece EGL e OpenGL ES para o RetroArch.

if BR2_PACKAGE_BRISA_MALI

config BR2_PACKAGE_PROVIDES_LIBEGL
	default "brisa-mali"

config BR2_PACKAGE_PROVIDES_LIBGLES
	default "brisa-mali"

endif
```

## buildroot/package/brisa-retroarch/Config.in
```kconfig
config BR2_PACKAGE_BRISA_RETROARCH
	bool "brisa-retroarch"
	depends on BR2_PACKAGE_HAS_LIBEGL
	depends on BR2_PACKAGE_HAS_LIBGLES
	depends on BR2_PACKAGE_HAS_UDEV
	depends on BR2_INSTALL_LIBSTDCPP
	select BR2_PACKAGE_ALSA_LIB
	select BR2_PACKAGE_ZLIB
	help
	  RetroArch compilado para a Mali-G31 em modo fbdev
	  (EGL direto no framebuffer, sem X11/Wayland/KMS).

comment "brisa-retroarch precisa do brisa-mali e do eudev"
	depends on !BR2_PACKAGE_HAS_LIBEGL || !BR2_PACKAGE_HAS_UDEV
```

## buildroot/package/brisa-ui/Config.in
```kconfig
config BR2_PACKAGE_BRISA_UI
	bool "brisa-ui"
	select BR2_PACKAGE_DEJAVU
	select BR2_PACKAGE_DEJAVU_SANS
	help
	  Interface do Brisa OS. Desenha direto no framebuffer e lê os
	  controles pelo evdev, sem depender da GPU.
```

## buildroot/package/brisa-vendor/Config.in
```kconfig
config BR2_PACKAGE_BRISA_VENDOR
	bool "brisa-vendor"
	help
	  Instala o que foi extraído do firmware stock da Anbernic
	  (scripts/extract-vendor.sh): módulos do kernel 4.9, firmware
	  do Wi-Fi, perfis de controle do RetroArch e hw.conf.

if BR2_PACKAGE_BRISA_VENDOR

config BR2_PACKAGE_BRISA_VENDOR_DIR
	string "diretório vendor"
	default "$(BR2_EXTERNAL_BRISA_PATH)/../vendor"

endif
```

## buildroot/package/libretro-fceumm/Config.in
```kconfig
config BR2_PACKAGE_LIBRETRO_FCEUMM
	bool "libretro-fceumm"
	depends on BR2_INSTALL_LIBSTDCPP
	help
	  Core FCEUmm: NES e Famicom.
```

## buildroot/package/libretro-gambatte/Config.in
```kconfig
config BR2_PACKAGE_LIBRETRO_GAMBATTE
	bool "libretro-gambatte"
	depends on BR2_INSTALL_LIBSTDCPP
	help
	  Core Gambatte: Game Boy e Game Boy Color.
```

## buildroot/package/libretro-mgba/Config.in
```kconfig
config BR2_PACKAGE_LIBRETRO_MGBA
	bool "libretro-mgba"
	depends on BR2_INSTALL_LIBSTDCPP
	help
	  Core mGBA: Game Boy Advance.
```

## buildroot/package/libretro-pcsx-rearmed/Config.in
```kconfig
config BR2_PACKAGE_LIBRETRO_PCSX_REARMED
	bool "libretro-pcsx-rearmed"
	depends on BR2_INSTALL_LIBSTDCPP
	help
	  Core PCSX ReARMed: PlayStation, com dynarec ARM64.
```

## buildroot/package/libretro-picodrive/Config.in
```kconfig
config BR2_PACKAGE_LIBRETRO_PICODRIVE
	bool "libretro-picodrive"
	depends on BR2_INSTALL_LIBSTDCPP
	help
	  Core PicoDrive: Master System, Game Gear, Mega Drive, Mega CD e 32X.
```

## buildroot/package/libretro-snes9x/Config.in
```kconfig
config BR2_PACKAGE_LIBRETRO_SNES9X
	bool "libretro-snes9x"
	depends on BR2_INSTALL_LIBSTDCPP
	help
	  Core Snes9x: Super Nintendo.
```
